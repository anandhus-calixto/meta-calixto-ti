## conf/layer.conf
```bitbake
BBPATH .= ":${LAYERDIR}"

BBFILE_COLLECTIONS += "meta-calixto-ti"
# Pattern for recipes in this layer
BBFILE_PATTERN_meta-calixto-ti := "^${LAYERDIR}/"
# Layer priority
BBFILE_PRIORITY_meta-calixto-ti = "99"
# Recipes and bbappends
BBFILES += "${LAYERDIR}/recipes-*/*/*.bb \
            ${LAYERDIR}/recipes-*/*/*.bbappend"
# Yocto compatible series
LAYERSERIES_COMPAT_meta-calixto-ti = "kirkstone scarthgap styhead walnascar whinlatter"
```

## conf/machine/create-calixto-image.inc
```bitbake
create_am335x_versa_image () {

CALIXTO_IMAGE_PATH_SDCARD="${DEPLOY_DIR_IMAGE}/calixto-images/${MACHINE}/sdcard"

rm -rf ${CALIXTO_IMAGE_PATH_SDCARD}
mkdir -p ${CALIXTO_IMAGE_PATH_SDCARD}

echo "DEPLOY_DIR_IMAGE = ${DEPLOY_DIR_IMAGE}"
echo "MACHINE = ${MACHINE}"

cp ${DEPLOY_DIR_IMAGE}/MLO ${CALIXTO_IMAGE_PATH_SDCARD}/MLO
#cp ${B}/MLO.byteswap ${CALIXTO_IMAGE_PATH_SDCARD}/MLO.byteswap
cp ${DEPLOY_DIR_IMAGE}/u-boot.img ${CALIXTO_IMAGE_PATH_SDCARD}/u-boot.img
cp ${DEPLOY_DIR_IMAGE}/${KERNEL_DEVICETREE} ${CALIXTO_IMAGE_PATH_SDCARD}/
cp ${DEPLOY_DIR_IMAGE}/${IMAGE_LINK_NAME}.rootfs.tar.xz  ${CALIXTO_IMAGE_PATH_SDCARD}/

}
```

## conf/machine/include/ti33x.inc
```bitbake
require conf/machine/include/ti-soc.inc
SOC_FAMILY:append = ":ti33x"

DEFAULTTUNE ?= "armv7athf-neon"
require conf/machine/include/arm/armv7a/tune-cortexa8.inc

require conf/machine/include/ti-bsp.inc

# Graphics providers and variables
require conf/machine/include/mesa-pvr.inc
PREFERRED_PROVIDER_virtual/gpudriver ?= "${BSP_SGX_DRIVER_PROVIDER}"

KERNEL_IMAGETYPE = "zImage"

#KERNEL_DEVICETREE_PREFIX = " \
#    am335x \
#    ti/omap/am335x \
#"

#KERNEL_DEVICETREE = " \
#    ti/omap/am335x-calixto-nxt512.dtb \
#"

UBOOT_ARCH = "arm"
#UBOOT_MACHINE = "am335x_evm_config"

UBOOT_ENTRYPOINT = "0x80008000"
UBOOT_LOADADDRESS = "0x80008000"


SPL_BINARY = "MLO"
UBOOT_SUFFIX = "img"

# Use the expected value of the ubifs filesystem's volume name in the kernel
# and u-boot.
UBI_VOLNAME = "rootfs"

EXTRA_IMAGEDEPENDS += "virtual/bootloader"

MACHINE_ESSENTIAL_EXTRA_RDEPENDS += "kernel-image-zimage"

MACHINE_ESSENTIAL_EXTRA_RRECOMMENDS += "amx3-cm3 prueth-fw pruhsr-fw pruprp-fw"

# List common SoC features, may need to add touchscreen for specific machines
MACHINE_FEATURES = "apm usbgadget usbhost vfat ext2 alsa"

IMAGE_FSTYPES += "tar.xz wic.xz wic.bmap"
WKS_FILE ?= "sdimage-2part.wks"
IMAGE_BOOT_FILES ?= "${SPL_BINARY} u-boot.${UBOOT_SUFFIX}"
do_image_wic[depends] += "virtual/bootloader:do_deploy"
```
